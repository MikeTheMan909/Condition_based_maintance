
#include "main.h"
#include "sensor.h"
#include "Debug/debug.h"
#include "Comm/comm.h"
#include "vibration_math.h"
#include "data_structs.h"
// Accelerometer

const char *sensormod = "SENSOR";
#define sensor_print_debug(str) print_debug(sensormod, str);
#define sensor_printf_debug(format,...) \
		printf_debug(sensormod, format, ##__VA_ARGS__);

struct L3 vibration;

uint8_t sensor_setup()
{
	uint8_t status;
	//Writing 0x00 to CNTL1 (0x1b) puts the sensor in stand-by mode, we can now change the settings
	uint8_t I2C_Tx_Buffer = 0x00;
	if((status = HAL_I2C_Mem_Write(&hi2c1, (uint16_t)ACCELEROMETER_I2C_ADDRESS<<1, 0x1b, 1, &I2C_Tx_Buffer, 1, 100)))
	{
		sensor_printf_debug("Error: cannot initialize accelerometer sensor (1), status = %d\r\n", status);
	}

	//Writing 0x0f to ODCNTL (0x21) sets the output data rate at 25600 Hz
	I2C_Tx_Buffer = 0x0f;
	if((status = HAL_I2C_Mem_Write(&hi2c1, (uint16_t)ACCELEROMETER_I2C_ADDRESS<<1, 0x21, 1, &I2C_Tx_Buffer, 1, 100)))
	{
		sensor_printf_debug("Error: cannot initialize accelerometer sensor (2), status = %d\r\n", status);
	}

	//Writing 0xc0 to CNTL1 (0x1b) puts the sensor in operating mode, high performance mode, range +- 8g
	I2C_Tx_Buffer = 0xc0;
	if((status = HAL_I2C_Mem_Write(&hi2c1, (uint16_t)ACCELEROMETER_I2C_ADDRESS<<1, 0x1b, 1, &I2C_Tx_Buffer, 1, 100)))
	{
		sensor_printf_debug("Error: cannot initialize accelerometer sensor (3), status = %d\r\n", status);
	}
	return status;
}

void sensor_readAcceleroRegister(uint8_t reg)
{
	uint8_t I2C_Rx_Buffer[6];
	HAL_I2C_Mem_Read(&hi2c1, (uint16_t)ACCELEROMETER_I2C_ADDRESS<<1, reg, 1, I2C_Rx_Buffer, 4, 100);
	sensor_printf_debug("%c",I2C_Rx_Buffer[0]);
	sensor_printf_debug("%c",I2C_Rx_Buffer[1]);
	sensor_printf_debug("%c",I2C_Rx_Buffer[2]);
	sensor_printf_debug("%c",I2C_Rx_Buffer[3]);
}
//Temp
float sensor_readTemperature()
{
// Point to Temperature Register 0x00 to retrieve its value in the next I2C command
	uint8_t status;
	uint8_t I2C_Tx_Buffer = 0x00;
	uint8_t I2C_Rx_Buffer[2];
	int temp = 0;
	float temperature;
	if((status = HAL_I2C_Master_Transmit(&hi2c1, (uint16_t)(TEMPERATURE_I2C_ADDRESS<<1), &I2C_Tx_Buffer, 1, 100)))
	{
		sensor_printf_debug("Error: cannot initialize temperature sensor, status = %d\r\n", status);
	}

	HAL_Delay(1000); // TODO: Delay really necessary? Alternatively use conversion ready interrupt?

	// Read Temperature Register, 16 bit value in 2 byte format
	if((status = HAL_I2C_Master_Receive(&hi2c1,(uint16_t)(TEMPERATURE_I2C_ADDRESS<<1), I2C_Rx_Buffer, 2, 100)))
	{
		sensor_printf_debug("Error: cannot sample temperature sensor, status = %d\r\n", status);
	}
	temp = I2C_Rx_Buffer[0] << 8 | I2C_Rx_Buffer[1] << 0;
	temperature = temp * TEMP_CONVERTION;

	return temperature;
}


uint8_t accelerometer_sample()
{
	uint8_t status = 0;

    uint8_t I2C_Rx_Buffer[6]; // 2 bytes per axis * 3 axes = 6;

	int16_t xRaw[VIBRATION_SAMPLE_SIZE] = {11986, 7724, 14961, 9776, 12514, 7741, 19546, 6879, 20257, 9232, 10253, 9112, 16469,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 15265, 20269};
	int16_t yRaw[VIBRATION_SAMPLE_SIZE] = {20073, 7080, -7340, -1855, 4592, -2209, 13704, -9494, 19549, -2839, -246, -1737, 2600,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 -4054, 15920};
	int16_t zRaw[VIBRATION_SAMPLE_SIZE] = {-14080, -15616, 18432, -18688, 15360, 13568, -17408, 20224, 512, 8448, 7168, -7680, 5632,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 2560, -15360};

    uint32_t sampleIndex = 0;

    //TIM5->ARR = (uint32_t)((51200/ACCELEROMETER_SAMPLE_RATE)-1);
	HAL_TIM_Base_Start_IT(&htim5);

	// Sample accelerometer
    while(sampleIndex < (VIBRATION_SAMPLE_SIZE))
	{
		if(trigger)
		{
			trigger = false;
			if((status = HAL_I2C_Mem_Read(&hi2c1, (uint16_t)ACCELEROMETER_I2C_ADDRESS<<1, 0x08, 1, I2C_Rx_Buffer, 6, 100)))
			{
				sensor_printf_debug("Error: cannot sample accelerometer sensor, status = %d\r\n", status);
				xRaw[sampleIndex] = 0;
				yRaw[sampleIndex] = 0;
				zRaw[sampleIndex] = 0;
				break;
			}
			else
			{
				xRaw[sampleIndex] = I2C_Rx_Buffer[0]<<8 | I2C_Rx_Buffer[1];
				yRaw[sampleIndex] = I2C_Rx_Buffer[2]<<8 | I2C_Rx_Buffer[3];
				zRaw[sampleIndex] = I2C_Rx_Buffer[4]<<8 | I2C_Rx_Buffer[5];
			}
			sampleIndex++;
		}
	}

    sampleIndex = 0;

    HAL_TIM_Base_Stop_IT(&htim5);
//
	// Convert signals to float
	arm_q15_to_float(xRaw, vibration.x.acceleration.samples, VIBRATION_SAMPLE_SIZE);
	arm_q15_to_float(yRaw, vibration.y.acceleration.samples, VIBRATION_SAMPLE_SIZE);
	arm_q15_to_float(zRaw, vibration.z.acceleration.samples, VIBRATION_SAMPLE_SIZE);

	// Subtract mean from signal to remove DC component
	subtract_mean(vibration.x.acceleration.samples, VIBRATION_SAMPLE_SIZE);
	subtract_mean(vibration.y.acceleration.samples, VIBRATION_SAMPLE_SIZE);
	subtract_mean(vibration.z.acceleration.samples, VIBRATION_SAMPLE_SIZE);

	// Scale sensor output to correct value in g
	arm_scale_f32(vibration.x.acceleration.samples, ACCELEROMETER_G_RANGE, vibration.x.acceleration.samples, VIBRATION_SAMPLE_SIZE);
	arm_scale_f32(vibration.y.acceleration.samples, ACCELEROMETER_G_RANGE, vibration.y.acceleration.samples, VIBRATION_SAMPLE_SIZE);
	arm_scale_f32(vibration.z.acceleration.samples, ACCELEROMETER_G_RANGE, vibration.z.acceleration.samples, VIBRATION_SAMPLE_SIZE);

	return status;
}

void sensor_fillStruct(struct sensor_values *sensor_value)
{
	 sensor_value->temperature = sensor_readTemperature();
	 sensor_printf_debug("value temp = %f",sensor_value->temperature);
	 sensor_value->acc.x.crest = vibration.x.acceleration.crest.new;
	 sensor_value->acc.x.rms = vibration.x.acceleration.rms.new;
	 sensor_value->acc.x.peak = vibration.x.acceleration.peak.new;

	 sensor_value->acc.y.crest = vibration.y.acceleration.crest.new;
	 sensor_value->acc.y.rms = vibration.y.acceleration.rms.new;
	 sensor_value->acc.y.peak = vibration.y.acceleration.peak.new;

	 sensor_value->acc.z.crest = vibration.z.acceleration.crest.new;
	 sensor_value->acc.z.rms = vibration.z.acceleration.rms.new;
	 sensor_value->acc.z.peak = vibration.z.acceleration.peak.new;

	 sensor_value->velo.x.crest = vibration.x.velocity.crest.new;
	 sensor_value->velo.x.rms = vibration.x.velocity.rms.new;
	 sensor_value->velo.x.peak = vibration.x.velocity.peak.new;

	 sensor_value->velo.y.crest = vibration.y.velocity.crest.new;
	 sensor_value->velo.y.rms = vibration.y.velocity.rms.new;
	 sensor_value->velo.y.peak = vibration.y.velocity.peak.new;

	 sensor_value->velo.z.crest = vibration.z.velocity.crest.new;
	 sensor_value->velo.z.rms = vibration.z.velocity.rms.new;
	 sensor_value->velo.z.peak = vibration.z.velocity.peak.new;

	 sensor_value->disp.x.rms = vibration.x.displacement.rms.new;
	 sensor_value->disp.x.peak = vibration.x.displacement.peak.new;

	 sensor_value->disp.y.rms = vibration.y.displacement.rms.new;
	 sensor_value->disp.y.peak = vibration.y.displacement.peak.new;

	 sensor_value->disp.z.rms = vibration.z.displacement.rms.new;
	 sensor_value->disp.z.peak = vibration.z.displacement.peak.new;

	 sensor_printf_debug("value temperature = %f", sensor_value->temperature);
	 sensor_printf_debug("value x acc rms = %f", sensor_value->acc.x.rms);
	 sensor_printf_debug("value x acc peak= %f", sensor_value->acc.x.peak);
	 sensor_printf_debug("value x acc crest = %f", sensor_value->acc.x.crest);
	 sensor_printf_debug("value y acc rms = %f", sensor_value->acc.y.rms);
	 sensor_printf_debug("value y acc peak= %f", sensor_value->acc.y.peak);
	 sensor_printf_debug("value y acc crest= %f", sensor_value->acc.y.crest);
	 sensor_printf_debug("value z acc rms= %f", sensor_value->acc.z.rms);
	 sensor_printf_debug("value z acc peak= %f", sensor_value->acc.z.peak);
	 sensor_printf_debug("value z acc crest = %f", sensor_value->acc.z.crest);

	 sensor_printf_debug("value x velo rms= %f", sensor_value->velo.x.rms);
	 sensor_printf_debug("value x velo peak= %f", sensor_value->velo.x.peak);
	 sensor_printf_debug("value x velo crest= %f", sensor_value->velo.x.crest);
	 sensor_printf_debug("value y velo rms= %f", sensor_value->velo.y.rms);
	 sensor_printf_debug("value y velo peak= %f", sensor_value->velo.y.peak);
	 sensor_printf_debug("value y velo crest= %f", sensor_value->velo.y.crest);
	 sensor_printf_debug("value z velo rms= %f", sensor_value->velo.z.rms);
	 sensor_printf_debug("value z velo peak= %f", sensor_value->velo.z.peak);
	 sensor_printf_debug("value z velo crest= %f", sensor_value->velo.z.crest);

	 sensor_printf_debug("value x disp rms= %f", sensor_value->disp.x.rms);
	 sensor_printf_debug("value x disp peak= %f", sensor_value->disp.x.peak);
	 sensor_printf_debug("value y disp rms= %f", sensor_value->disp.y.rms);
	 sensor_printf_debug("value y disp peak= %f", sensor_value->disp.y.peak);
	 sensor_printf_debug("value z disp rms= %f", sensor_value->disp.z.rms);
	 sensor_printf_debug("value z disp peak= %f", sensor_value->disp.z.peak);
}



